## build/conf/bblayers.conf
```bitbake
# POKY_BBLAYERS_CONF_VERSION is increased each time build/conf/bblayers.conf
# changes incompatibly
POKY_BBLAYERS_CONF_VERSION = "2"

BBPATH = "${TOPDIR}"
BBFILES ?= ""

BBLAYERS ?= " \
  /home/mitch/git/screwing_with_bitbake/meta-raspberrypi/ \
  /home/mitch/git/screwing_with_bitbake/poky/meta \
  /home/mitch/git/screwing_with_bitbake/poky/meta-poky \
  /home/mitch/git/screwing_with_bitbake/poky/meta-yocto-bsp \
  "
```
